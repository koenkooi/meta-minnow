## conf/layer.conf
```bitbake
# We have a conf and classes directory, add to BBPATH
BBPATH .= ":${LAYERDIR}"

# We have a recipes directory, add to BBFILES
BBFILES += "${LAYERDIR}/recipes-*/*/*.bb \
            ${LAYERDIR}/recipes-*/*/*.bbappend"

BBFILE_COLLECTIONS += "minnow"
BBFILE_PATTERN_minnow := "^${LAYERDIR}/"
BBFILE_PRIORITY_minnow = "6"

LAYERDEPENDS_minnow = "intel"

# Additional license directories.
LICENSE_PATH += "${LAYERDIR}/custom-licenses"
```

## conf/machine/include/meta-intel-emgd.inc
```bitbake
INHERIT += "emgd-gl"
GLSUFFIX = "-emgd"
PACKAGE_EXTRA_ARCHS_append = " ${TUNE_PKGARCH}${GLSUFFIX}"


#
# XSERVER subcomponents, used to build the XSERVER variable
#

# for Xserver older than 1.13.0
OLD_XSERVER_X86_EXT = "xserver-xorg-extension-dri \
           xserver-xorg-extension-dri2 \
           xserver-xorg-extension-extmod \
           xserver-xorg-extension-dbe \
           "
XSERVER_X86_EMGD = "emgd-driver-bin \
           ${OLD_XSERVER_X86_EXT} \
           "
PREFERRED_PROVIDER_virtual/mesa ?= "mesa-gl"
PREFERRED_PROVIDER_virtual/libgl ?= "mesa-gl"
PREFERRED_PROVIDER_virtual/libgles1 ?= "emgd-driver-bin"
PREFERRED_PROVIDER_virtual/libgles2 ?= "emgd-driver-bin"
PREFERRED_PROVIDER_virtual/egl ?= "emgd-driver-bin"
```

## conf/machine/minnow.conf
```bitbake
#@TYPE: Machine
#@NAME: minnow

#@WEBTITLE: Intel Atom E640T Processor with Intel EG20T Controller Hub Development Kit (Queens Bay) with Proprietary IEMGD Accelerated Graphics.

#@DESCRIPTION: Machine configuration for MinnowBoard v1 (Intel Atom E640T). For the MinnowBoard MAX (Intel Atom E38xx), please use the meta-intel intel-corei7-64 BSP: http://www.elinux.org/Minnowboard:MinnowMaxYoctoProject

require conf/machine/include/intel-core2-32-common.inc
require conf/machine/include/meta-intel.inc

MACHINE_HWCODECS ?= "va-intel"

MACHINE_FEATURES += "efi va-impl-mixvideo wifi"

PREFERRED_PROVIDER_virtual/kernel ?= "linux-yocto-old"
PREFERRED_VERSION_linux-yocto-old = "3.10%"

XSERVER ?= "${XSERVER_X86_BASE} \
            ${XSERVER_X86_EXT} \
            ${XSERVER_X86_FBDEV} \
           "

APPEND += "console=ttyPCH0,115200 console=tty0 vmalloc=256MB \
           snd-hda-intel.enable_msi=0 \
          "
SERIAL_CONSOLE = "115200 ttyPCH0"
GRUB_OPTS = "terminal_input console"

# Linux kernel drivers for onboard hardware
MACHINE_ESSENTIAL_EXTRA_RRECOMMENDS += " \
kernel-module-snd-hda-intel \
kernel-module-lpc-sch \
kernel-module-gpio-sch \
kernel-module-pch-gbe \
kernel-module-pch-udc \
kernel-module-gpio-pch \
kernel-module-leds-gpio \
kernel-module-input-polldev \
kernel-module-gpio-keys-polled \
kernel-module-minnowboard \
kernel-module-minnowboard-gpio \
kernel-module-minnowboard-keys \
kernel-module-spidev \
kernel-module-i2c-dev \
kernel-module-iwlwifi \
"

# Include all firmware packages for the most compatible experience
MACHINE_EXTRA_RRECOMMENDS += "linux-firmware"
```
